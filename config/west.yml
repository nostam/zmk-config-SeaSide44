## config/west.yml
```yaml
manifest:
  remotes:
    - name: zmkfirmware
      url-base: https://github.com/zmkfirmware
    - name: caksoylar
      url-base: https://github.com/caksoylar
    - name: nostam
      url-base: https://github.com/nostam
    - name: oleksandrmaslov
      url-base: https://github.com/oleksandrmaslov
    - name: kot149
      url-base: https://github.com/kot149
  projects:
    - name: zmk
      remote: zmkfirmware
      revision: v0.3
      import: app/west.yml
    - name: zmk-pmw3610-driver
      remote: nostam
      revision: pm
    - name: zmk-behavior-sensor-attr-cycle
      remote: nostam
      revision: central
    - name: zmk-pointing-acceleration
      remote: oleksandrmaslov
      revision: 0da8f97f8f2abb18fcc9d488b25357511922cf32
    - name: zmk-scroll-snap
      remote: kot149
      revision: 62a669c32353576df18d6f835ccb2133e2238e1d
    - name: zmk-smart-toggle
      remote: caksoylar
      revision: 46e178221cccef965a511b772d7bc62800f1542e
    - name: zmk-rgbled-widget
      remote: caksoylar
      revision: v0.3-branch
  self:
    path: config
```
